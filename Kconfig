## Kconfig
```kconfig
config KITE
    bool "Enable the Kite library"
    default n
    help
      This option enables the Kite library, which provides a collection of utilities and features for embedded applications. If your application does not require the functionality provided by the Kite library, you can disable this option to save memory and reduce code size.

if KITE

# Logging
module = KITE
module-str = Kite library
source "subsys/logging/Kconfig.template.log_config"

rsource "src/Kconfig.ByteStream"
rsource "src/HTTP/Kconfig.HTTP"

endif # KITE
```

## src/HTTP/Kconfig.HTTP
```kconfig
config KITE_HTTP
    bool "Enable HTTP support in the Kite library"
    default n
    depends on KITE_BYTE_STREAM && HTTP_SERVER
    help
      This option enables HTTP support in the Kite library, allowing for handling of HTTP requests and responses. If your application does not require HTTP functionality, you can disable this option to save memory and reduce code size.

if KITE_HTTP

# Logging
module = KITE_HTTP
module-str = Kite library HTTP support
source "subsys/logging/Kconfig.template.log_config"


endif # KITE_HTTP
```

## src/Kconfig.ByteStream
```kconfig
config KITE_BYTE_STREAM
    bool "Enable byte stream support in the Kite library"
    default n
    help
      This option enables byte stream support in the Kite library, allowing for efficient handling of binary data. If your application does not require byte stream functionality, you can disable this option to save memory and reduce code size.

if KITE_BYTE_STREAM

config KITE_BYTE_STREAM_DEFAULT_BUFFER_SIZE
    int "Default buffer size for byte stream"
    default 256
    help
      This option sets the default buffer size for byte stream operations in the Kite library. Adjust this value based on your application's memory constraints and performance requirements.

endif # KITE_BYTE_STREAM
```

## src/MQTT/Kconfig.MQTT
```kconfig
config KITE_MQTT
    bool "Enable MQTT support in the Kite library"
    default n
    depends on KITE_BYTE_STREAM && MQTT_LIB
    help
      This option enables MQTT support in the Kite library, allowing for handling of MQTT messages. If your application does not require MQTT functionality, you can disable this option to save memory and reduce code size.

if KITE_MQTT

# Logging
module = KITE_MQTT
module-str = Kite library MQTT support
source "subsys/logging/Kconfig.template.log_config"

config KITE_MQTT_THREAD_STACK_SIZE
    int "MQTT client thread stack size in bytes"
    default 2048

config KITE_MQTT_THREAD_PRIORITY
    int "MQTT client thread priority"
    default 5

config KITE_MQTT_RX_BUFFER_SIZE
    int "MQTT socket RX buffer size in bytes"
    default 512

config KITE_MQTT_TX_BUFFER_SIZE
    int "MQTT socket TX buffer size in bytes"
    default 512

config KITE_MQTT_PAYLOAD_BUFFER_SIZE
    int "Scratch buffer size for inbound publish payloads in bytes"
    default 512
    help
      Payloads larger than this value are truncated before dispatch.

config KITE_MQTT_MAX_SUBSCRIPTIONS
    int "Maximum number of concurrent topic subscriptions"
    default 8

config KITE_MQTT_MAX_TOPIC_LEN
    int "Maximum topic string length (excluding null terminator)"
    default 128

config KITE_MQTT_MAX_BROKER_HOST_LEN
    int "Maximum broker hostname/IP string length (excluding null terminator)"
    default 64

config KITE_MQTT_MAX_CLIENT_ID_LEN
    int "Maximum client ID string length (excluding null terminator)"
    default 64

config KITE_MQTT_MAX_CREDENTIAL_LEN
    int "Maximum username/password string length (excluding null terminator)"
    default 64

config KITE_MQTT_CONNECT_TIMEOUT_MS
    int "Timeout in ms to wait for a CONNACK after mqtt_connect()"
    default 5000

config KITE_MQTT_RECONNECT_DELAY_MS
    int "Delay in ms between connection/reconnection attempts"
    default 3000

config KITE_MQTT_CONNECT_MAX_RETRIES
    int "Maximum consecutive connection attempts before pausing"
    default 5

config KITE_MQTT_POLL_TIMEOUT_MS
    int "Maximum time in ms to block in poll() waiting for broker data"
    default 500

endif # KITE_MQTT
```

## src/Serial/Kconfig.Serial
```kconfig
config KITE_SERIAL
    bool "Enable Serial support in the Kite library"
    default n
    depends on KITE_BYTE_STREAM && SERIAL
    help
      This option enables Serial support in the Kite library, allowing for handling of Serial communication. If your application does not require Serial functionality, you can disable this option to save memory and reduce code size.

if KITE_SERIAL

# Logging
module = KITE_SERIAL
module-str = Kite library Serial support
source "subsys/logging/Kconfig.template.log_config"

config KITE_SERIAL_UART_ASYNC_RX_BUF_SIZE
    int "UART async RX buffer size in bytes (per buffer)"
    depends on UART_ASYNC_API
    default 256
    help
      Size of each of the two RX double-buffers used by UartAsync.

config KITE_SERIAL_UART_ASYNC_TX_BUF_SIZE
    int "UART async TX buffer size in bytes"
    depends on UART_ASYNC_API
    default 256
    help
      Size of the internal DRAM TX buffer used by UartAsync. Data is copied
      into this buffer before being passed to uart_tx so that DMA can access it
      regardless of where the caller's buffer resides (flash, stack, etc.).

endif # KITE_SERIAL
```
